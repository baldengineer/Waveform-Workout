## firmware/boards/baldee/waveform_workout/Kconfig.waveform_workout
```kconfig
# SPDX-License-Identifier: MIT

config BOARD_WAVEFORM_WORKOUT
	select SOC_STM32L072XX
```

## firmware/boards/baldee/waveform_workout/board.yml
```yaml
board:
  name: waveform_workout
  full_name: Waveform Workout Rev 1
  vendor: baldee
  socs:
    - name: stm32l072xx
```
